## configs/holly_defconfig
```kconfig
CONFIG_ARM=y
CONFIG_POSITION_INDEPENDENT=y
CONFIG_DRIVER_GICV2=y
CONFIG_SYS_THUMB_BUILD=y
CONFIG_ARCH_MEDIATEK=y
CONFIG_SUPPORT_PASSING_ATAGS=y
CONFIG_TEXT_BASE=0x81e00000
CONFIG_SYS_MALLOC_LEN=0x2000000
CONFIG_SYS_MALLOC_F_LEN=0x8000
CONFIG_NR_DRAM_BANKS=1
CONFIG_HAS_CUSTOM_SYS_INIT_SP_ADDR=y
CONFIG_CUSTOM_SYS_INIT_SP_ADDR=0x81ffff10
CONFIG_DM_GPIO=y
CONFIG_DEFAULT_DEVICE_TREE="mt6582-huawei-holly"
CONFIG_DM_RESET=y
CONFIG_BOARD_HOLLY=y
CONFIG_SYS_LOAD_ADDR=0x84000000
CONFIG_DEBUG_UART_BASE=0x11005000
CONFIG_DEBUG_UART_CLOCK=26000000
CONFIG_DEBUG_UART=y
CONFIG_LOCALVERSION="-mt6582"
CONFIG_CC_OPTIMIZE_FOR_SPEED=y
CONFIG_OPTIMIZE_INLINING=y
CONFIG_ENV_VARS_UBOOT_CONFIG=y
CONFIG_AUTOBOOT_KEYED=y
CONFIG_AUTOBOOT_MENU_SHOW=y
CONFIG_FDT_SIMPLEFB=y
CONFIG_DEFAULT_FDT_FILE="mt6582-huawei-holly.dtb"
CONFIG_LOGLEVEL=6
CONFIG_SYS_STDIO_DEREGISTER=y
# CONFIG_SYS_DEVICE_NULLDEV is not set
CONFIG_LOG_MAX_LEVEL=7
CONFIG_HUSH_PARSER=y
CONFIG_SYS_PROMPT="U-Boot => "
CONFIG_CMD_BDINFO_EXTRA=y
CONFIG_CMD_UFETCH=y
CONFIG_CMD_BOOTZ=y
CONFIG_CMD_BOOTEFI_HELLO=y
CONFIG_CMD_BOOTMENU=y
CONFIG_CMD_MEMINFO=y
CONFIG_CMD_MEMINFO_MAP=y
# CONFIG_CMD_BIND is not set
CONFIG_CMD_DM=y
CONFIG_CMD_GPIO=y
CONFIG_CMD_GPIO_READ=y
CONFIG_CMD_MMC=y
CONFIG_CMD_SDRAM=y
CONFIG_CMD_CAT=y
CONFIG_CMD_BSP=y
CONFIG_CMD_PAUSE=y
CONFIG_CMD_PMIC=y
CONFIG_CMD_DIAG=y
CONFIG_CMD_LOG=y
CONFIG_DOS_PARTITION=y
CONFIG_EFI_PARTITION=y
CONFIG_PARTITION_TYPE_GUID=y
CONFIG_VERSION_VARIABLE=y
CONFIG_NO_NET=y
CONFIG_BUTTON=y
CONFIG_BUTTON_REMAP_PHONE_KEYS=y
CONFIG_CLK=y
CONFIG_DMA=y
CONFIG_SYS_I2C_MTK=y
CONFIG_DM_KEYBOARD=y
CONFIG_BUTTON_KEYBOARD=y
CONFIG_IOMMU=y
CONFIG_SUPPORT_EMMC_BOOT=y
CONFIG_MMC_HS400_SUPPORT=y
CONFIG_MMC_SDHCI=y
CONFIG_MMC_MTK=y
CONFIG_PHY=y
CONFIG_PHY_MTK_TPHY=y
CONFIG_PINCTRL=y
CONFIG_PINCONF=y
CONFIG_PINCTRL_MT7623=y
CONFIG_POWER_DOMAIN=y
CONFIG_MTK_POWER_DOMAIN=y
CONFIG_DM_PMIC=y
CONFIG_DM_REGULATOR=y
CONFIG_DM_REGULATOR_FIXED=y
CONFIG_POWER_MT6323=y
CONFIG_RESET_SYSCON=y
CONFIG_DM_SERIAL=y
CONFIG_DEBUG_UART_ANNOUNCE=y
CONFIG_MTK_SERIAL=y
CONFIG_SYSRESET=y
CONFIG_SYSRESET_WATCHDOG=y
CONFIG_TIMER=y
CONFIG_MTK_TIMER=y
CONFIG_USB=y
CONFIG_DM_USB_GADGET=y
CONFIG_USB_GADGET=y
CONFIG_USB_GADGET_VENDOR_NUM=0x18d1
CONFIG_USB_GADGET_PRODUCT_NUM=0xd001
CONFIG_USB_GADGET_DOWNLOAD=y
CONFIG_USB_FUNCTION_MASS_STORAGE=y
CONFIG_VIDEO=y
# CONFIG_VIDEO_LOGO is not set
CONFIG_SYS_WHITE_ON_BLACK=y
CONFIG_VIDEO_LCD_NOVATEK_NT35510=y
CONFIG_DISPLAY=y
CONFIG_VIDEO_SIMPLE=y
CONFIG_VIDEO_DT_SIMPLEFB=y
CONFIG_VIDEO_BMP_RLE8=y
CONFIG_WDT_MTK=y
CONFIG_CC_OPTIMIZE_LIBS_FOR_SPEED=y
CONFIG_PANIC_HANG=y
CONFIG_CIRCBUF=y
# CONFIG_TOOLS_MKEFICAPSULE is not set
```
